## drivers/char/Kconfig.mtk
```kconfig
# SPDX-License-Identifier: GPL-2.0
#
# Character device configuration
#

source "drivers/char/hw_random/Kconfig.mtk"
source "drivers/char/rpmb/Kconfig"
```

## drivers/cpufreq/Kconfig.mtk
```kconfig
# SPDX-License-Identifier: GPL-2.0-only
menu "CPU Frequency scaling"

if ARM || ARM64
source "drivers/cpufreq/Kconfig-mtk.arm"
endif

endmenu
```

## drivers/interconnect/Kconfig.mtk
```kconfig
# SPDX-License-Identifier: GPL-2.0-only

if INTERCONNECT

source "drivers/interconnect/mediatek/Kconfig.mtk"

endif
```

## drivers/mihw/Kconfig
```kconfig
config CACHE_PREFETCH
	tristate "mi cache prefetch module"
	default n
	help
	  cache prefetch module

config MI_MILLET
	tristate "Xiaomi Millet notifications"
	depends on ANDROID_BINDER_IPC && ANDROID_VENDOR_HOOKS
	depends on CGROUP_FREEZER && NETFILTER && IPV6
	depends on NF_SOCKET_IPV4 && NF_SOCKET_IPV6
	help
	  Report frozen-process Binder, signal and socket activity to the
	  Millet userspace monitors. Support the framework core-UID and
	  blacklist policy for native Binder thaw notifications.

config MI_MEMORY_INFO
	tristate "Xiaomi DDR and UFS identity"
	depends on OF && SCSI_UFSHCD && PM
	help
	  Supply DDR and UFS identity through /proc/mv using bootloader
	  memory metadata and standard UFS read descriptors.

config MI_SLA
	tristate "Xiaomi SLA traffic collector"
	depends on INET && NETFILTER && PROC_FS
	depends on NF_SOCKET_IPV4
	help
	  Collect per-interface packet timing and traffic information for
	  Xiaomi network services. Does not change packet routing.

config MI_MINET
	tristate "Xiaomi Minet per-UID traffic statistics"
	depends on INET && IPV6 && NETFILTER && PROC_FS
	depends on NF_SOCKET_IPV4 && NF_SOCKET_IPV6
	help
	  Supply bounded per-UID IP flow counters to Xiaomi network services.

config MI_MIWILL
	tristate "Xiaomi MiWiLL wireless link aggregation"
	depends on INET && IPV6 && NETFILTER && NETDEVICES
	depends on NF_SOCKET_IPV4 && NF_SOCKET_IPV6
	help
	  Supply the MiWiLL virtual interface, packet encapsulation and
	  redundancy mode used by Xiaomi dual wireless network services.

config MI_MEMORY_MONITOR
	tristate "Xiaomi reclaim and kswapd monitoring"
	depends on TRACEPOINTS && TRACING && SYSFS && CPU_FREQ
	help
	  Report measured direct-reclaim latency and kswapd CPU time and
	  frequency to Xiaomi memory diagnostics. Does not alter reclaim policy.

config MI_THERMAL_INTERFACE
	tristate "Xiaomi thermal userspace interface"
	depends on OF && THERMAL && CPU_FREQ && POWER_SUPPLY
	depends on DEVICE_MODULES_DRM_MEDIATEK
	help
	  Supply Xiaomi thermal state nodes, CPU maximum-frequency requests
	  and primary-display and USB power-state notifications.
```

## drivers/misc/mediatek/usb/Kconfig
```kconfig
# SPDX-License-Identifier: GPL-2.0

source "drivers/misc/mediatek/usb/usb_meta/Kconfig"
source "drivers/misc/mediatek/usb/usb_rndis/Kconfig"
source "drivers/misc/mediatek/usb/usb_boost/Kconfig"
source "drivers/misc/mediatek/usb/usb_offload/Kconfig"
source "drivers/misc/mediatek/usb/usb_sram/Kconfig"
source "drivers/misc/mediatek/usb/usb_xhci/Kconfig"
source "drivers/misc/mediatek/usb/usb20/Kconfig"
source "drivers/misc/mediatek/usb/usb_logger/Kconfig"
```

## drivers/thermal/Kconfig.mtk
```kconfig
# SPDX-License-Identifier: GPL-2.0-only
#
# Generic thermal drivers configuration
#

if THERMAL

menu "Mediatek thermal drivers"
depends on ARCH_MEDIATEK || COMPILE_TEST
source "drivers/thermal/mediatek/Kconfig.mtk"
endmenu
```
